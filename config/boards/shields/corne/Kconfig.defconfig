## config/boards/shields/corne/Kconfig.defconfig
```kconfig
if SHIELD_CORNE_CENTRAL_DONGLE

config ZMK_KEYBOARD_NAME
    default "Corne"

config ZMK_SPLIT_ROLE_CENTRAL
    default y

endif

if SHIELD_CORNE_CENTRAL_DONGLE || SHIELD_CORNE_PERIPHERAL_LEFT || SHIELD_CORNE_PERIPHERAL_RIGHT

if ZMK_DISPLAY

config I2C
    default y

config SSD1306
    default y

endif # ZMK_DISPLAY

config ZMK_SPLIT
    default y
endif
```
