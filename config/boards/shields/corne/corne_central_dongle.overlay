/*
 * Copyright (c) 2020 Pete Johanson
 *
 * SPDX-License-Identifier: MIT
 */

#include "corne.dtsi"
&physical_layout0 {
    transform = <&default_transform>;
};
/ {
    chosen {
        zmk,kscan = &mock_kscan;
        zmk,physical_layout = &physical_layout0;
    };

    mock_kscan: kscan_0 {
        compatible = "zmk,kscan-mock";
        columns = <0>;
        rows = <0>;
        events = <0>;
    };
};
